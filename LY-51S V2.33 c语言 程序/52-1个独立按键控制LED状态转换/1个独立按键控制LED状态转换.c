/*-----------------------------------------------
  名称：单个独立按键控制led输出状态
  论坛：www.doflye.net
  编写：shifang
  日期：2009.5
  修改：无
  内容：按一次按键，led点亮，再按一次熄灭，以此循环
------------------------------------------------*/
#include<reg52.h> //包含头文件，一般情况不需要改动，头文件包含特殊功能寄存器的定义

sbit KEY=P3^3;  //定义按键输入端口
sbit LED=P1^2;  //定义led输出端口


void DelayUs2x(unsigned char t);//函数声明 
void DelayMs(unsigned char t);
/*------------------------------------------------
                    主函数
------------------------------------------------*/
void main (void)
{
                  
KEY=1; //按键输入端口电平置高
while (1)         //主循环
  {

  if(!KEY)  //如果检测到低电平，说明按键按下
    {
	 DelayMs(10); //延时去抖，一般10-20ms
     if(!KEY)     //再次确认按键是否按下，没有按下则退出
	   {
        while(!KEY);//如果确认按下按键等待按键释放，没有释放则一直等待
	       {
	       LED=!LED;//释放则执行需要的程序
	 		}
	   }
	}

     //主循环中添加其他需要一直工作的程序
	
  }
}
/*------------------------------------------------
 uS延时函数，含有输入参数 unsigned char t，无返回值
 unsigned char 是定义无符号字符变量，其值的范围是
 0~255 这里使用晶振12M，精确延时请使用汇编,大致延时
 长度如下 T=tx2+5 uS 
------------------------------------------------*/
void DelayUs2x(unsigned char t)
{   
 while(--t);
}
/*------------------------------------------------
 mS延时函数，含有输入参数 unsigned char t，无返回值
 unsigned char 是定义无符号字符变量，其值的范围是
 0~255 这里使用晶振12M，精确延时请使用汇编
------------------------------------------------*/
void DelayMs(unsigned char t)
{
     
 while(t--)
 {
     //大致延时1mS
     DelayUs2x(245);
	 DelayUs2x(245);
 }
}
