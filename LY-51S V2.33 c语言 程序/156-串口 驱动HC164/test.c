/*-----------------------------------------------
  名称：串口控制74HC164
  论坛：www.doflye.net
  编写：shifang
  日期：2009.5
  修改：无 测试平台 LY-51S 
  内容：通过单片机自带串口TXD、RXD控制74HC164，从而控制LED显示
        P3.0接J11 A、B，P3.1接J11 CLK，输出J12用8根杜邦线接LED端子J9
------------------------------------------------*/
#include<reg52.h>

/*------------------------------------------------
 uS延时函数，含有输入参数 unsigned char t，无返回值
 unsigned char 是定义无符号字符变量，其值的范围是
 0~255 这里使用晶振12M，精确延时请使用汇编,大致延时
 长度如下 T=tx2+5 uS 
------------------------------------------------*/
void DelayUs2x(unsigned char t)
{   
 while(--t);
}
/*------------------------------------------------
 mS延时函数，含有输入参数 unsigned char t，无返回值
 unsigned char 是定义无符号字符变量，其值的范围是
 0~255 这里使用晶振12M，精确延时请使用汇编
------------------------------------------------*/
void DelayMs(unsigned char t)
{
     
 while(t--)
 {
     //大致延时1mS
     DelayUs2x(245);
	 DelayUs2x(245);
 }
}
/*------------------------------------------------
                   串口发送数据
------------------------------------------------*/
void wr_byte(unsigned char num)   
{   
    SBUF = num; //发送数据   
    while (!TI);   
    TI = 0; //发送完毕，清中断标志   
}   
/*------------------------------------------------
                   主函数
------------------------------------------------*/
main()
{
 unsigned char num;
 SCON = 0x00; //设置串行口工作方式0，发送 rx数据端，低位在前，高位在后；
 
 while(1)
 {
  wr_byte(num);
  num++;
  DelayMs(100);
 }
}
